## nordic_code/build_1/Kconfig/Kconfig.shield.defconfig
```kconfig
osource "/home/makrron/Compartido/TFG/bitcoin-wallet/nordic_code/boards/shields/*/Kconfig.defconfig"
osource "/home/makrron/ncs/v2.6.0/nrf/boards/shields/*/Kconfig.defconfig"
```
