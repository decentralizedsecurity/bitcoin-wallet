## CMakeLists.txt
```
#
# Copyright (c) 2021 Nordic Semiconductor ASA
#
# SPDX-License-Identifier: LicenseRef-Nordic-5-Clause
#

cmake_minimum_required(VERSION 3.20.0)

find_package(Zephyr REQUIRED HINTS $ENV{ZEPHYR_BASE})

project(hardware_wallet)

# Incluir directorios
include_directories(include)

target_sources(app PRIVATE
        src/main.c
        src/buttons.c
        src/menu.c
        src/crypto.c
        src/base58.c
        src/privateKey.c
        src/publicKey.c
        src/hex_bytes.c
        src/pk2hash.c
        src/ripemd160.c
        src/generateAddress.c
        src/memzero.c)
```

## prj.conf
```kconfig
# The Zephyr CMSIS emulation assumes that ticks are ms, currently
CONFIG_SYS_CLOCK_TICKS_PER_SEC=1000

CONFIG_MAIN_STACK_SIZE=8192
CONFIG_HEAP_MEM_POOL_SIZE=8192

# Enable logging
CONFIG_CONSOLE=y
CONFIG_LOG=y

# Enable nordic security backend and PSA APIs
CONFIG_NRF_SECURITY=y

CONFIG_MBEDTLS_ENABLE_HEAP=y
CONFIG_MBEDTLS_HEAP_SIZE=8192

CONFIG_PSA_WANT_ALG_ECDSA=y
CONFIG_PSA_WANT_KEY_TYPE_ECC_KEY_PAIR=y
CONFIG_PSA_WANT_ECC_SECP_R1_256=y
CONFIG_PSA_WANT_ALG_SHA_256=y

# For key generation
CONFIG_PSA_WANT_GENERATE_RANDOM=y

CONFIG_OBERON_BACKEND=y
CONFIG_MBEDTLS_PSA_CRYPTO_C=y
CONFIG_PSA_CRYPTO_DRIVER_OBERON=n
CONFIG_PSA_CRYPTO_DRIVER_CC3XX=y
CONFIG_MBEDTLS_LEGACY_CRYPTO_C=y
CONFIG_THREAD_LOCAL_STORAGE=y
CONFIG_COMMON_LIBC_MALLOC=y
```

## src/main.c
```c
#include <zephyr/kernel.h>
#include <zephyr/sys/printk.h>
#include <stdio.h>
#include <stdlib.h>
#include "privateKey.h"
#include "pk2hash.h"
#include "publicKey.h"
#include "hex_bytes.h"
#include "generateAddress.h"
#include "psa/crypto.h"
#include "psa/protected_storage.h"

#define PRIVATE_KEY_ID 0x01  // Identificador único para la clave privada

int main() {
    printk("Iniciando...\n");
    psa_status_t status;
    char private_key[129]; // espacio para 64 bytes en hexadecimal + '\0'
    memset(private_key, 0, sizeof(private_key)); // inicializar a 0 para asegurar que esté terminado en NULL

    status = psa_crypto_init();
    if (status != PSA_SUCCESS) {
        printk("Failed to initialize PSA Crypto\n");
        return 1;
    }

    size_t data_length;
    // Intentar recuperar la clave privada
    size_t private_key_len = sizeof(private_key);
    status = psa_ps_get(PRIVATE_KEY_ID, 0, private_key_len, private_key, &data_length);
    
    if (status != PSA_SUCCESS) { // Clave privada no existe
        printk("La clave privada no existe\n Iniciando generacion de clave privada...\n");
        // Clave no existe, generar una nueva
        char* generated_key = generate_private_key();
        if (!generated_key) {
            printk("Failed to generate private key\n");
            return 1;
        }

        memcpy(private_key, generated_key, private_key_len);
        free(generated_key); // Libera la clave generada después de copiarla
        // Almacenar la nueva clave privada
        status = psa_ps_set(PRIVATE_KEY_ID, private_key_len, private_key, PSA_STORAGE_FLAG_WRITE_ONCE);
        if (status != PSA_SUCCESS) {
            printk("Failed to store private key\n");
            return 1;
        }
        printk("Clave privada generada y almacenada\n");
    }else{ // Clave privada recuperada con éxito, mostramos datos
        printk("Clave privada recuperada\n");
        
        printk("Clave Privada: %s\n", private_key);

        char* wif = convert_private_key_to_wif(private_key, 1);
        if (!wif) {
            printk("Failed to convert private key to WIF\n");
            return 1;
        }

        printk("Clave Privada WIF: %s\n", wif);

        unsigned char public_key[33]; // Tamaño correcto para clave pública comprimida
        size_t public_key_len = sizeof(public_key);
        
        if (generate_public_key_from_hex(private_key, public_key, &public_key_len)) {
            char* public_key_hex = bytes_to_hex(public_key, public_key_len);
            printk("[COMPRESSED] Hex Public Key: %s\n", public_key_hex);

            char* hash160 = malloc(41); // 20 bytes en hexadecimal
            publicKeytoHash(public_key_hex, hash160);
            printk("Public Key Hash: %s\n", hash160);

            char* address = P2PKH_address(hash160, 1);
            if (address) {
                printk("Direccion P2PKH: %s\n", address);
                free(address);
            } else {
                printk("Error al generar la dirección P2PKH.\n");
            }

            free(public_key_hex);
            free(hash160);
        } else {
            printk("Failed to generate public key\n");
        }

        free(wif);
    }
    
    return 0;
}
```

## include/base58.h
```c
#ifndef BASE58_H
#define BASE58_H

// Función para codificar una cadena hexadecimal a Base58.
void encode_base58(const char *hex, char *output);
void decode_base58(const char* base58, char* output);


#endif //BASE58_H
```

## include/buttons.h
```c
#ifndef BUTTONS_H
#define BUTTONS_H

void setup_buttons(void);

#endif // BUTTONS_H
```

## include/generateAddress.h
```c
//
// Created by makrron on 15/04/24.
//

#ifndef GENERATEADDRESS_H
#define GENERATEADDRESS_H

char* P2PKH_address(const char* public_key_hash_hex, int network); // Función para generar una dirección P2PKH. Recibe el hash de la clave pública y la red (0 para mainnet y 1 para testnet).

#endif //GENERATEADDRESS_H
```

## include/hex_bytes.h
```c
#ifndef HEX_TO_BYTES_H
#define HEX_TO_BYTES_H

#include <stddef.h> // para size_t

// Declara la función hex_to_bytes para que pueda ser utilizada por otros archivos
int hex_to_bytes(const char *hex, unsigned char *bytes, size_t bytes_len);
char* bytes_to_hex(const unsigned char* bytes, size_t len);

#endif // HEX_TO_BYTES_H
```

## include/menu.h
```c
#ifndef MENU_H
#define MENU_H

#include <zephyr/types.h>
#include <zephyr/devicetree.h>
#include <zephyr/drivers/gpio.h>

// Estados del menú
typedef enum {
    MENU_MAIN,
    MENU_GENERATE_PRIVATE_KEY,
    MENU_GENERATE_PUBLIC_KEY,
    MENU_SIGN_TRANSACTION,
    MENU_EXIT
} menu_state_t;

void print_menu_options(void);
void button_0_callback(const struct device *dev, struct gpio_callback *cb, uint32_t pins);
void button_1_callback(const struct device *dev, struct gpio_callback *cb, uint32_t pins);
void handle_menu_action(void);

#endif // MENU_H
```

## include/pk2hash.h
```c
//
// Created by makrron on 11/04/24.
//

#ifndef PK2HASH_H
#define PK2HASH_H

void publicKeytoHash(char*, char *output);

#endif //PK2HASH_H
```

## include/privateKey.h
```c
#ifndef PRIVATEKEY_H
#define PRIVATEKEY_H

#include <stdlib.h>

char* to_hexadecimal(unsigned char* hash, size_t size); // Convierte un hash en bytes a una cadena hexadecimal
char* generate_private_key(); // Genera una clave privada aleatoria
char* convert_private_key_to_wif(const char* hex_priv_key, int mainnet); // Convierte una clave privada en formato hexadecimal a formato WIF (Wallet Import Format)

#endif //PRIVATEKEY_H
```

## include/publicKey.h
```c
#ifndef PUBLIC_KEY_H
#define PUBLIC_KEY_H

#include <stdlib.h> // para size_t

int generate_public_key_from_hex(const char *private_key_hex, unsigned char *public_key, size_t *public_key_len);
void compress_pubkey(const unsigned char *uncompressed_key, unsigned char *compressed_key); // La api de nordic no tiene esta función, por lo que tenemos que implementarla

#endif // PUBLIC_KEY_H
```

## src/base58.c
```c
#include "base58.h"
#include <stdio.h>
#include <stdlib.h>
#include <string.h>

const char BASE58_CHARS[] = "123456789ABCDEFGHJKLMNPQRSTUVWXYZabcdefghijkmnopqrstuvwxyz";

/**
 * Codifica una cadena hexadecimal a Base58.
 * @param hex Cadena hexadecimal.
 * @param output Buffer para almacenar la cadena Base58.
 */
void encode_base58(const char *hex, char *output) {
    int values[256]; // Mapeo de caracteres hexadecimales a valores enteros.
    for (int i = 0; i < 256; i++) {
        values[i] = -1;
    }
    for (int i = '0'; i <= '9'; i++) {
        values[i] = i - '0';
    }
    for (int i = 'A'; i <= 'F'; i++) {
        values[i] = i - 'A' + 10;
    }
    for (int i = 'a'; i <= 'f'; i++) {
        values[i] = i - 'a' + 10;
    }

    unsigned char *bin = malloc(strlen(hex) / 2);
    size_t bin_size = 0;
    for (size_t i = 0; hex[i] && hex[i+1]; i += 2) {
        bin[bin_size++] = values[hex[i]] * 16 + values[hex[i+1]];
    }

    // Convertir el número binario a Base58.
    int digits[40] = {0}; // Suponer que el número base58 resultante tiene menos de 40 dígitos.
    int num_digits = 0;
    for (size_t i = 0; i < bin_size; i++) {
        int carry = bin[i];
        for (int j = 0; j < num_digits; j++) {
            carry += digits[j] << 8;
            digits[j] = carry % 58;
            carry /= 58;
        }
        while (carry > 0) {
            digits[num_digits++] = carry % 58;
            carry /= 58;
        }
    }

    // Convertir dígitos en caracteres Base58.
    for (int i = 0; i < num_digits; i++) {
        output[num_digits - i - 1] = BASE58_CHARS[digits[i]];
    }
    output[num_digits] = '\0';

    free(bin);
}

/**
 * Decodifica una cadena Base58 a hexadecimal.
 * @param base58 Cadena Base58.
 * @param output Buffer para almacenar la cadena hexadecimal.
 */
void decode_base58(const char* base58, char* output) {
    int values[256]; // Mapeo de caracteres Base58 a valores enteros.
    for (int i = 0; i < 256; i++) {
        values[i] = -1;
    }
    for (int i = 0; BASE58_CHARS[i]; i++) {
        values[(int)BASE58_CHARS[i]] = i;
    }

    unsigned char *bin = calloc(strlen(base58), sizeof(char));
    size_t bin_size = 0;

    for (size_t i = 0; i < strlen(base58); i++) {
        int value = values[(int)base58[i]];
        if (value == -1) {
            fprintf(stderr, "Invalid Base58 character: %c\n", base58[i]);
            free(bin);
            return; // Terminar con error si hay un carácter inválido.
        }
        int carry = value;
        for (size_t j = 0; j < bin_size; j++) {
            carry += bin[j] * 58;
            bin[j] = carry % 256;
            carry /= 256;
        }
        while (carry > 0) {
            bin[bin_size++] = carry % 256;
            carry /= 256;
        }
    }

    // Convertir el número binario a hexadecimal.
    for (int i = 0; i < bin_size; i++) {
        sprintf(output + 2*i, "%02x", bin[bin_size - i - 1]);
    }
    output[2 * bin_size] = '\0'; // Terminar la cadena.

    free(bin);
}
```

## src/buttons.c
```c
#include "buttons.h"
#include <zephyr/device.h>
#include <zephyr/drivers/gpio.h>
#include <zephyr/sys/printk.h>
#include "menu.h" // Para usar los callbacks de los botones

static const struct gpio_dt_spec button0 = GPIO_DT_SPEC_GET_OR(DT_ALIAS(sw0), gpios, {0});
static const struct gpio_dt_spec button1 = GPIO_DT_SPEC_GET_OR(DT_ALIAS(sw1), gpios, {0});
static struct gpio_callback button0_cb_data;
static struct gpio_callback button1_cb_data;

void setup_buttons(void) {
    if (!device_is_ready(button0.port) || !device_is_ready(button1.port)) {
        printk("Error: botón no está listo.\n");
        return;
    }

    // Configurar el botón 0
    gpio_pin_configure_dt(&button0, GPIO_INPUT);
    gpio_pin_interrupt_configure_dt(&button0, GPIO_INT_EDGE_TO_ACTIVE);
    gpio_init_callback(&button0_cb_data, button_0_callback, BIT(button0.pin));
    gpio_add_callback(button0.port, &button0_cb_data);

    // Configurar el botón 1
    gpio_pin_configure_dt(&button1, GPIO_INPUT);
    gpio_pin_interrupt_configure_dt(&button1, GPIO_INT_EDGE_TO_ACTIVE);
    gpio_init_callback(&button1_cb_data, button_1_callback, BIT(button1.pin));
    gpio_add_callback(button1.port, &button1_cb_data);
}
```

## src/crypto.c
```c
#include "crypto.h"
#include <zephyr/kernel.h>
#include <zephyr/sys/printk.h>
#include <zephyr/logging/log.h>
#include <stdio.h>
#include <stdlib.h>
#include <psa/crypto.h>
#include <psa/crypto_extra.h>

#ifdef CONFIG_BUILD_WITH_TFM
#include <tfm_ns_interface.h>
#endif

#define PRINT_HEX(p_label, p_text, len)\
	({\
		LOG_INF("---- %s (len: %u): ----", p_label, len);\
		LOG_HEXDUMP_INF(p_text, len, "Content:");\
		LOG_INF("---- %s end  ----", p_label);\
	})

LOG_MODULE_REGISTER(ecdsa, LOG_LEVEL_DBG);

static uint8_t m_plain_text[NRF_CRYPTO_EXAMPLE_ECDSA_TEXT_SIZE] = {
    "Example string to demonstrate basic usage of ECDSA."
};

static uint8_t m_pub_key[NRF_CRYPTO_EXAMPLE_ECDSA_PUBLIC_KEY_SIZE];
static uint8_t m_signature[NRF_CRYPTO_EXAMPLE_ECDSA_SIGNATURE_SIZE];
static uint8_t m_hash[NRF_CRYPTO_EXAMPLE_ECDSA_HASH_SIZE];

static psa_key_id_t keypair_id;
static psa_key_id_t pub_key_id;

// Aquí van las implementaciones de tus funciones como se definieron anteriormente...
// Por ejemplo:

int crypto_init(void)
{
	psa_status_t status;

	// Initialize PSA Crypto 
	status = psa_crypto_init();
	if (status != PSA_SUCCESS) {
		LOG_INF("psa_crypto_init failed! (Error: %d)", status);
		return APP_ERROR;
	}

	return APP_SUCCESS;
}

int crypto_finish(void)
{
	psa_status_t status;

	// Destroy the key handle 
	status = psa_destroy_key(keypair_id);
	if (status != PSA_SUCCESS) {
		LOG_INF("psa_destroy_key failed! (Error: %d)", status);
		return APP_ERROR;
	}

	status = psa_destroy_key(pub_key_id);
	if (status != PSA_SUCCESS) {
		LOG_INF("psa_destroy_key failed! (Error: %d)", status);
		return APP_ERROR;
	}

	return APP_SUCCESS;
}



int generate_ecdsa_keypair(void)
{
    psa_status_t status;
    size_t olen;

    LOG_INF("Generating random ECDSA keypair...");

    // Configure the key attributes 
    psa_key_attributes_t key_attributes = PSA_KEY_ATTRIBUTES_INIT;

    psa_set_key_usage_flags(&key_attributes, PSA_KEY_USAGE_SIGN_HASH);
    psa_set_key_lifetime(&key_attributes, PSA_KEY_LIFETIME_VOLATILE);
    psa_set_key_algorithm(&key_attributes, PSA_ALG_ECDSA(PSA_ALG_SHA_256));
    psa_set_key_type(&key_attributes, PSA_KEY_TYPE_ECC_KEY_PAIR(PSA_ECC_FAMILY_SECP_K1)); // Modificado para usar secp256k1
    psa_set_key_bits(&key_attributes, 256);

    status = psa_generate_key(&key_attributes, &keypair_id);
    if (status != PSA_SUCCESS) {
        LOG_INF("psa_generate_key failed! (Error: %d)", status);
        return APP_ERROR;
    }

    // Export the public key 
    status = psa_export_public_key(keypair_id, m_pub_key, sizeof(m_pub_key), &olen);
    if (status != PSA_SUCCESS) {
        LOG_INF("psa_export_public_key failed! (Error: %d)", status);
        return APP_ERROR;
    }

    psa_reset_key_attributes(&key_attributes);

    return APP_SUCCESS;
}


int import_ecdsa_pub_key(void)
{
    psa_key_attributes_t key_attributes = PSA_KEY_ATTRIBUTES_INIT;
    psa_status_t status;

    psa_set_key_usage_flags(&key_attributes, PSA_KEY_USAGE_VERIFY_HASH);
    psa_set_key_lifetime(&key_attributes, PSA_KEY_LIFETIME_VOLATILE);
    psa_set_key_algorithm(&key_attributes, PSA_ALG_ECDSA(PSA_ALG_SHA_256));
    psa_set_key_type(&key_attributes, PSA_KEY_TYPE_ECC_PUBLIC_KEY(PSA_ECC_FAMILY_SECP_K1)); // Modificado para usar secp256k1
    psa_set_key_bits(&key_attributes, 256);

    status = psa_import_key(&key_attributes, m_pub_key, sizeof(m_pub_key), &pub_key_id);
    if (status != PSA_SUCCESS) {
        LOG_INF("psa_import_key failed! (Error: %d)", status);
        return APP_ERROR;
    }

    psa_reset_key_attributes(&key_attributes);

    return APP_SUCCESS;
}


int sign_message(void)
{
	uint32_t output_len;
	psa_status_t status;

	LOG_INF("Signing a message using ECDSA...");

	// Compute the SHA256 hash
	status = psa_hash_compute(PSA_ALG_SHA_256,
				  m_plain_text,
				  sizeof(m_plain_text),
				  m_hash,
				  sizeof(m_hash),
				  &output_len);
	if (status != PSA_SUCCESS) {
		LOG_INF("psa_hash_compute failed! (Error: %d)", status);
		return APP_ERROR;
	}

	// Sign the hash 
	status = psa_sign_hash(keypair_id,
			       PSA_ALG_ECDSA(PSA_ALG_SHA_256),
			       m_hash,
			       sizeof(m_hash),
			       m_signature,
			       sizeof(m_signature),
			       &output_len);
	if (status != PSA_SUCCESS) {
		LOG_INF("psa_sign_hash failed! (Error: %d)", status);
		return APP_ERROR;
	}

	LOG_INF("Message signed successfully!");
	PRINT_HEX("Plaintext", m_plain_text, sizeof(m_plain_text));
	PRINT_HEX("SHA256 hash", m_hash, sizeof(m_hash));
	PRINT_HEX("Signature", m_signature, sizeof(m_signature));

	return APP_SUCCESS;
}


int verify_message(void)
{
	psa_status_t status;

	LOG_INF("Verifying ECDSA signature...");

	// Verify the signature of the hash 
	status = psa_verify_hash(pub_key_id,
				 PSA_ALG_ECDSA(PSA_ALG_SHA_256),
				 m_hash,
				 sizeof(m_hash),
				 m_signature,
				 sizeof(m_signature));
	if (status != PSA_SUCCESS) {
		LOG_INF("psa_verify_hash failed! (Error: %d)", status);
		return APP_ERROR;
	}

	LOG_INF("Signature verification was successful!");

	return APP_SUCCESS;
}

/*
int main(void)
{
	int status;

	LOG_INF("Starting ECDSA example...");

	status = crypto_init();
	if (status != APP_SUCCESS) {
		LOG_INF(APP_ERROR_MESSAGE);
		return APP_ERROR;
	}

	status = generate_ecdsa_keypair();
	if (status != APP_SUCCESS) {
		LOG_INF(APP_ERROR_MESSAGE);
		return APP_ERROR;
	}

	status = import_ecdsa_pub_key();
	if (status != APP_SUCCESS) {
		LOG_INF(APP_ERROR_MESSAGE);
		return APP_ERROR;
	}

	status = sign_message();
	if (status != APP_SUCCESS) {
		LOG_INF(APP_ERROR_MESSAGE);
		return APP_ERROR;
	}

	status = verify_message();
	if (status != APP_SUCCESS) {
		LOG_INF(APP_ERROR_MESSAGE);
		return APP_ERROR;
	}

	status = crypto_finish();
	if (status != APP_SUCCESS) {
		LOG_INF(APP_ERROR_MESSAGE);
		return APP_ERROR;
	}

	LOG_INF(APP_SUCCESS_MESSAGE);

	return APP_SUCCESS;
}
*/
```

## src/crypto.h
```c
#ifndef CRYPTO_H_
#define CRYPTO_H_

#include <stdint.h>
#include <stddef.h>
#include <psa/crypto.h>

#define APP_SUCCESS (0)
#define APP_ERROR   (-1)

#define APP_SUCCESS_MESSAGE "Example finished successfully!"
#define APP_ERROR_MESSAGE "Example exited with error!"

#define NRF_CRYPTO_EXAMPLE_ECDSA_TEXT_SIZE (100)
#define NRF_CRYPTO_EXAMPLE_ECDSA_PUBLIC_KEY_SIZE (65)
#define NRF_CRYPTO_EXAMPLE_ECDSA_SIGNATURE_SIZE (64)
#define NRF_CRYPTO_EXAMPLE_ECDSA_HASH_SIZE (32)


extern int crypto_init(void);
extern int crypto_finish(void);
extern int generate_ecdsa_keypair(void);
extern int import_ecdsa_pub_key(void);
extern int sign_message(void);
extern int verify_message(void);

#endif // CRYPTO_H_
```
